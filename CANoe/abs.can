/*@!Encoding:949*/
includes {
}

variables {
  // send message
  message ABS_Info_Cluster abs_msg;
  message ABS_Alive abs_alive_msg;
  message CCAN::ABS_Pos_Respond_OTA abs_pos_msg;
  message CCAN::ABS_Neg_Respond_OTA abs_neg_msg;


  // timer
  msTimer t_200ms;
  msTimer t_5ms;

  // var
  int brake_pressed = 0;
  int cur_speed = 0;
  int prev_speed = 0;

  float decel = 0.0; 
  int abs_active = 0;

  int my_ecu_name = 5;
  int rxbuffer[1500];
  int rxoffset = 0;
  int metadata_recved = 0;

}

on start {
  setTimerCyclic(t_200ms, 200); 
  setTimerCyclic(t_5ms, 5);
}

on message Motor_Info_ECU {
  cur_speed = this.sig_car_speed;
}

on message Brake_Control_ECU {
  brake_pressed = this.sig_brake_pressed;
}

on timer t_5ms
{
  if(@sysvar::`ABS::abs_error==0)
    output(abs_alive_msg);
}

on timer t_200ms {
  decel = ((float)(prev_speed - cur_speed)) / 0.2;

  if (brake_pressed && decel > 25.0) {
    abs_active = 1;
  } else {
    abs_active = 0;
  }

  abs_msg.sig_abs_active = abs_active;
  if(@sysvar::`ABS::abs_error==0)
    output(abs_msg);

  prev_speed = cur_speed;
}

on message CCAN::VUM_Request_ECU
{
  if(this.sig_sid ==0x12)
  {
    cancelTimer(t_5ms);
    cancelTimer(t_200ms);
    abs_pos_msg.sig_sid = this.sig_sid+0x40;
    output(abs_pos_msg);
  }
  
  if(this.sig_sid ==0x15)
  {
    if(metadata_recved ==1)
    {
      if (rxoffset+1 == @sysvar::OTA::ccan_file_size)
      {
        abs_pos_msg.sig_sid = this.sig_sid+0x40;
      }
      else
      {
        abs_neg_msg.sig_neg_respond = 0x7F;
        abs_neg_msg.sig_sid = this.sig_sid;
      }
    }
  }
  
}

on message CCAN::VUM_Metadata_ECU
{
  if(this.sig_ecu_name == my_ecu_name)
  {
    @sysvar::OTA::ccan_file_size = this.sig_file_size;
    abs_pos_msg.sig_sid = this.sig_sid+0x40;
    output(abs_pos_msg);
    metadata_recved = 1;
  }
  
}

on message C_CAN::VUM_File_ABS
{
  int count = 0;
  for(count=0;count<8;count++)
  {
    rxbuffer[rxoffset] = this.byte(count);
    rxoffset++; 
  }
}
