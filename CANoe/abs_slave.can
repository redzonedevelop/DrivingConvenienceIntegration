/*@!Encoding:949*/
includes {
  
}

variables {
  //send message
  message ABS_Info_Cluster abs_msg;
  message ABS_Slave_Active abs_slave_msg;

  //timer
  msTimer t_abs;
  msTimer t_alive;

  //var
  int alive_miss_count = 0;
  int is_slave_active = 0;

  int brake_pressed = 0;
  int cur_speed = 0;
  int prev_speed = 0;

  float decel = 0.0;
  int abs_active = 0;
  int abs_prev = 0;
  
  float v1;
  float v2;
  float tmp1;
  float tmp2;

}

on start {
  setTimerCyclic(t_alive, 5); 
}

on message ABS_Alive
{
  alive_miss_count = 0;
}

// 속도 수신 (km/h)
on message Motor_Info_ECU 
{
  cur_speed = this.sig_car_speed;
}

// 브레이크 입력 수신 (flag: 0 or 1)
on message Brake_Control_ECU 
{
  brake_pressed = this.sig_brake_pressed;
}

on timer t_alive
{
  alive_miss_count++;
  if (alive_miss_count > 3 && is_slave_active == 0)
  {
    is_slave_active = 1;
    prev_speed = cur_speed; // 초기화
    setTimerCyclic(t_abs, 5);
    output(abs_slave_msg);
    write("abs_Slave on");
  }
}

// ABS 판단 로직 (5ms 주기)
on timer t_abs {
  tmp1 = prev_speed;
  tmp2 = cur_speed;

  v1 = tmp1 / 3.6;
  v2 = tmp2 / 3.6;
  decel = (v1 - v2) / 0.005;            // m/s²

  // ABS ON 조건 
  if (brake_pressed && decel > 20.0 && cur_speed > 10) {
    abs_active = 1;
  }
  // OFF 조건
  else if (abs_active && (decel < 10.0 || !brake_pressed || cur_speed < 5)) {
    abs_active = 0;
  }

  // 상태 변화 시 메시지 전송
  if (abs_active != abs_prev) {
    abs_msg.sig_abs_active = abs_active;  // 0 or 1
    output(abs_msg);
    abs_prev = abs_active;
  }

  // 다음 주기 준비
  prev_speed = cur_speed;
}

