/*@!Encoding:949*/
includes
{
  
}

variables
{
  msTimer sendTimer;
  //int control_accel;
}

on start
{
  setTimerCyclic(sendTimer,10);
}

on timer sendTimer
{

  message ADASCAN::ADAS_Control_Steering steering_msg;
  message ADASCAN::ADAS_Control_Motor motor_msg;
  //int steeringValue;

  //steeringValue = @sysvar::Steering::control_steering;

  steering_msg.sig_control_steering = @sysvar::Steering::control_steering;
  motor_msg.sig_control_accerleration = @sysvar::Motor::control_acceleration;


  
  //msg.id = 0x11;
  //msg.dlc = 2; // signed int는 2 byte (16bit)
  //msg.byte(0) = steeringValue >> 8;
  //msg.byte(1) = steeringValue;

  write("Steering = %d, accel = %d", @sysvar::Steering::control_steering,@sysvar::Motor::control_acceleration);
  output(motor_msg);
  output(steering_msg);
  
}
