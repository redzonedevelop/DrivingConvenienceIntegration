/*@!Encoding:949*/ 
includes
{
  
}

variables
{
  msTimer sendTimer10;
  msTimer sendTimer100;
  //int control_accel;
  message ADASCAN::ADAS_Control_Steering steering_msg;
  message ADASCAN::ADAS_Control_Motor motor_msg;
  message ADASCAN::ADAS_Info_Cluster adas_info_msg;
}

on start
{
  setTimerCyclic(sendTimer10,10);
  setTimerCyclic(sendTimer100,100);
}

on timer sendTimer10
{


  message ADASCAN::ADAS_Control_Steering steering_msg;
  message ADASCAN::ADAS_Control_Motor motor_msg;
  message ADASCAN::ADAS_Control_Brake brake_msg;

  //int steeringValue;
  //steeringValue = @sysvar::Steering::control_steering;

  steering_msg.sig_control_steering = @sysvar::Steering::control_steering;


  //brake_msg.sig_control_aeb = @sysvar::

  motor_msg.sig_control_accerleration = @sysvar::Motor::longitudinal_speed;



  
  //msg.id = 0x11;
  //msg.dlc = 2; // signed int�� 2 byte (16bit)
  //msg.byte(0) = steeringValue >> 8;
  //msg.byte(1) = steeringValue;

  write("Steering = %d, accel = %d", @sysvar::Steering::control_steering,@sysvar::Motor::longitudinal_speed);
  output(motor_msg);
  output(steering_msg);
  
}

on timer sendTimer100
{
  adas_info_msg.sig_ACC = 1;
  adas_info_msg.sig_LKA = 1;
  
  output(adas_info_msg);
}
