/*@!Encoding:949*/ 
includes
{
  
}

variables
{
  msTimer sendTimer10;
  msTimer sendTimer100;
  //int control_accel;
  message ADASCAN::ADAS_Control_Steering steering_msg;
  message ADASCAN::ADAS_Control_Motor motor_msg;
  message ADASCAN::ADAS_Info_Cluster adas_info_msg;
  message ADAS_Pos_Respond_OTA adas_pos_msg;
  message ADAS_Neg_Respond_OTA adas_neg_msg;
  
  int my_ecu_name = 8;
  int rxbuffer[1500];
  int rxoffset = 0;
  int metadata_recved = 0;
}

on start
{
  setTimerCyclic(sendTimer10,10);
  setTimerCyclic(sendTimer100,100);
}
/*
on timer sendTimer10
{
  if(@sysvar::Steering::adas_control_steering !=0)
  {
  steering_msg.sig_control_steering = @sysvar::Steering::adas_control_steering;
  @sysvar::Steering::control_steering = @sysvar::Steering::adas_control_steering;
  output(steering_msg);
  }
    if(@sysvar::Motor::adas_control_speed >0)
  {
    motor_msg.sig_control_accerleration = @sysvar::Motor::adas_control_speed;
    @sysvar::Motor::longitudinal_speed = @sysvar::Motor::adas_control_speed;
    output(motor_msg);
  }
  
}

on timer sendTimer100
{
  if(@sysvar::Motor::adas_control_speed>0)
  {
    adas_info_msg.sig_ACC = 1;
    adas_info_msg.sig_LKA = 1;//adas �� �������������� �ӵ��� �����ϸ� acc�� ������ ���� 
  }
  else
  {
    adas_info_msg.sig_ACC = 0;
    adas_info_msg.sig_LKA = 0;
  }
  
  
  output(adas_info_msg);
}

*/


on message ADASCAN::VUM_Request_ECU
{
  
  if(this.sig_sid ==0x12)
  {
    cancelTimer(sendTimer10);
    cancelTimer(sendTimer100);
    adas_pos_msg.sig_sid = this.sig_sid+0x40;
    output(adas_pos_msg);
  }
  
  if(this.sig_sid ==0x15)
  {
    if(metadata_recved ==1)
    {
      if (rxoffset+1 == @sysvar::OTA::adascan_file_size)
      {
        adas_pos_msg.sig_sid = this.sig_sid+0x40;
      }
      else
      {
        adas_neg_msg.sig_neg_respond = 0x7F;
        adas_neg_msg.sig_sid = this.sig_sid;
      }
    }
    
  }
  
  
  //negative
}


on message ADAS_CAN::VUM_Metadata_ECU
{
  if(this.sig_ecu_name == my_ecu_name)
  {
    @sysvar::OTA::adascan_file_size = this.sig_file_size;
    adas_pos_msg.sig_sid = this.sig_sid+0x40;
    output(adas_pos_msg);
    metadata_recved = 1;
  }
  
}

on message ADAS_CAN::VUM_File_ADAS
{
  int count = 0;
  for(count=0;count<8;count++)
  {
    rxbuffer[rxoffset] = this.byte(count);
    rxoffset++; 
  }
}

