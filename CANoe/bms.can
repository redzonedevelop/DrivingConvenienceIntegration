/*@!Encoding:949*/
includes
{

}

variables
{
  //send message
  message Battery_Info_Cluster battery_info_msg;
  message BMS_Pos_Respond_OTA bms_pos_msg;
  message BMS_Neg_Respond_OTA bms_neg_msg;
  //timer
  msTimer t_bms;
  
  //var
  int my_ecu_name = 2;
  int rxbuffer[20000];
  int rxoffset = 0;
  int metadata_recved = 0;
  
  // metadata
  int version = 0;
  int file_size = 0;
}

on start
{
  setTimerCyclic(t_bms, 100);
}

on timer t_bms
{
  battery_info_msg.sig_battery_level = 3;
  battery_info_msg.sig_charging_state = @sysvar::BMS::battery_charging_state;
  
  output(battery_info_msg);
}

on message PCAN::VUM_Request_ECU
{
  if(this.sig_sid ==0x12)
  {
    bms_pos_msg.sig_sid = this.sig_sid+0x40;
    output(bms_pos_msg);
  }
  
  if(this.sig_sid ==0x15)
  {
    if(metadata_recved ==1)
    {
      if (rxoffset == file_size)
      {
        bms_pos_msg.sig_sid = this.sig_sid+0x40;
      }
      else
      {
        bms_neg_msg.sig_neg_respond = 0x7F;
        bms_neg_msg.sig_sid = this.sig_sid;
      }
      output(bms_pos_msg);
    }
  }
  
  //negative
}

on message PCAN::VUM_Metadata_ECU
{
  if(this.sig_ecu_name == my_ecu_name)
  {
    file_size = this.sig_file_size;
    version = this.sig_version;
    bms_pos_msg.sig_sid = this.sig_sid + 0x40;
    output(bms_pos_msg);
    metadata_recved = 1;
  }
  write("metadata comes in!");
}

on message P_CAN::VUM_File_BMS
{
  int count = 0;
  int len = 0;

  if (file_size - rxoffset >= 8) {
    len = 8;
  }
  else {
    len = file_size - rxoffset;
  }
  for (count = 0;count < len;count++)
  {
    rxbuffer[rxoffset] = this.byte(count);
    rxoffset++;
  }

  if ((rxoffset % 4000 == 0) || rxoffset == file_size) {
    bms_pos_msg.sig_sid = 0x14 + 0x40;
    output(bms_pos_msg);
  }
  
  @sysvar::VUM::update_progress = (int)(((double)rxoffset / (double)file_size) * 100);

  write("payload comes in!, %d", rxoffset);
}