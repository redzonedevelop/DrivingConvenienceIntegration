/*@!Encoding:949*/
includes
{

}

variables
{
  //send message
  message Battery_Info_Cluster battery_info_msg;
  message BMS_Pos_Respond_OTA bms_pos_msg;
  //timer
  msTimer t_bms;
  
  //var
  
}

on start
{
  setTimerCyclic(t_bms, 100);
}

on timer t_bms
{
  battery_info_msg.sig_battery_level = 3;
  battery_info_msg.sig_charging_state = @sysvar::BMS::battery_charging_state;
  
  output(battery_info_msg);
}

on message PCAN::VUM_Request_ECU
{
  bms_pos_msg.sig_sid = this.sig_sid+0x40;
  output(bms_pos_msg);
  //negative
}
