/*@!Encoding:949*/
includes
{
  
}

variables
{
  //send message
  message Brake_Control_ECU Brake_Control_ECU;
  message Brake_Pos_Respond_OTA brake_pos_msg;
  message Brake_Neg_Respond_OTA brake_neg_msg;
  //timer
  msTimer t_brake;
  
  //var
  int brake_level=0;
  int my_ecu_name = 4;
  int rxbuffer[20000];
  int rxoffset = 0;
  int metadata_recved = 0;
  
  // metadata
  int version = 0;
  int file_size = 0;
}

on start
{
  setTimerCyclic(t_brake, 5);
}

on timer t_brake
{
  if (@Brake::brake_pressed == 1)
  {
    if(brake_level<100)
    {
      brake_level++;
      Brake_Control_ECU.sig_brake_pressed = 1;
      Brake_Control_ECU.sig_brake_level = brake_level;
    }
  }
  else
  {
    brake_level=0;
    Brake_Control_ECU.sig_brake_pressed = 0;
    Brake_Control_ECU.sig_brake_level = brake_level;
  }
  output(Brake_Control_ECU);
}

on message CCAN::VUM_Request_ECU
{
  if(this.sig_sid ==0x12)
  {
    brake_pos_msg.sig_sid = this.sig_sid+0x40;
    output(brake_pos_msg);
  }
  
  if(this.sig_sid ==0x15)
  {
    if(metadata_recved ==1)
    {
      if (rxoffset == file_size)
      {
        brake_pos_msg.sig_sid = this.sig_sid+0x40;
      }
      else
      {
        brake_neg_msg.sig_neg_respond = 0x7F;
        brake_neg_msg.sig_sid = this.sig_sid;
      }
      output(brake_pos_msg);
    }
  }
  
  //negative
}

on message CCAN::VUM_Metadata_ECU
{
  if(this.sig_ecu_name == my_ecu_name)
  {
    file_size = this.sig_file_size;
    version = this.sig_version;
    brake_pos_msg.sig_sid = this.sig_sid + 0x40;
    output(brake_pos_msg);
    metadata_recved = 1;
  }
  write("metadata comes in!");
}

on message C_CAN::VUM_File_Brake
{
  int count = 0;
  int len = 0;

  if (file_size - rxoffset >= 8) {
    len = 8;
  }
  else {
    len = file_size - rxoffset;
  }
  for (count = 0;count < len;count++)
  {
    rxbuffer[rxoffset] = this.byte(count);
    rxoffset++;
  }

  if ((rxoffset % 4000 == 0) || rxoffset == file_size) {
    brake_pos_msg.sig_sid = 0x14 + 0x40;
    output(brake_pos_msg);
  }
  
  @sysvar::VUM::update_progress = (int)(((double)rxoffset / (double)file_size) * 100);

  write("payload comes in!, %d", rxoffset);
}