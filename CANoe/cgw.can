/*@!Encoding:949*/
includes
{
  
}




variables
{
  //var
  int abs_error = 0;
  //P-CAN
  message PCAN::Brake_Control_Motor brake_control_p_msg;
  message PCAN::ADAS_Control_Motor motor_control_p_msg;
  
  //C-CAN
  message CCAN::Motor_Info_ECU motor_info_c_msg;
  message CCAN::ADAS_Control_Steering steering_control_c_msg;
  //B-CAN
  message BODY::Steering_Angle_Info_ECU steering_info_b_msg;
  //ADAS-CAN
  
  //OTA-CAN
  //OC-CAN
  message OCCAN::ABS_Info_Cluster abs_info_oc_msg;
  message OCCAN::ADAS_Info_Cluster adas_info_oc_msg;
  message OCCAN::AEB_Info_ECU aeb_info_oc_msg;
  message OCCAN::Battery_Info_Cluster battery_info_oc_msg;
  message OCCAN::Light_Info_Cluster light_info_oc_msg;
  message OCCAN::Motor_Info_ECU motor_info_oc_msg;
  message OCCAN::Steering_Angle_Info_ECU steering_angle_oc_msg;
  message OCCAN::Transmission_Info_ECU transmission_info_oc_msg;
}



//P-CAN
on message PCAN::Battery_Info_Cluster
{
  battery_info_oc_msg.sig_battery_level   = this.sig_battery_level;
  battery_info_oc_msg.sig_charging_state  = this.sig_charging_state;
  output(battery_info_oc_msg);
}



on message PCAN::BMS_Neg_Respond_OTA
{
  
}

on message PCAN::BMS_Pos_Respond_OTA
{
  
}

on message PCAN::BMS_Request_OBD
{
  
}

on message PCAN::Motor_Info_ECU
{
  motor_info_c_msg.sig_car_speed       = this.sig_car_speed;
  motor_info_c_msg.sig_wheel_speed_FL  = this.sig_wheel_speed_FL;
  motor_info_c_msg.sig_wheel_speed_FR  = this.sig_wheel_speed_FR;
  motor_info_c_msg.sig_wheel_speed_RL  = this.sig_wheel_speed_RL;
  motor_info_c_msg.sig_wheel_speed_RR  = this.sig_wheel_speed_RR;
  
  motor_info_oc_msg.sig_car_speed       = this.sig_car_speed;
  motor_info_oc_msg.sig_wheel_speed_FL  = this.sig_wheel_speed_FL;
  motor_info_oc_msg.sig_wheel_speed_FR  = this.sig_wheel_speed_FR;
  motor_info_oc_msg.sig_wheel_speed_RL  = this.sig_wheel_speed_RL;
  motor_info_oc_msg.sig_wheel_speed_RR  = this.sig_wheel_speed_RR;

  output(motor_info_c_msg);
  output(motor_info_oc_msg);
}

on message PCAN::Motor_Neg_Respond_OTA
{
  
}

on message PCAN::Motor_Pos_Respond_OTA
{
  
}

on message PCAN::Motor_Request_OBD
{
  
}

on message PCAN::Transmission_Info_ECU
{
  transmission_info_oc_msg.sig_gear_mode = this.sig_gear_mode;
  
  output(transmission_info_oc_msg);
}

on message Transmission_Neg_Respond_OTA
{
  
}

on message Transmission_Pos_Respond_OTA
{
  
}

on message Transmission_Request_OBD
{
  
}


//C-CAN
on message CCAN::ABS_Alive
{

}

on message CCAN::ABS_Info_Cluster
{
  abs_info_oc_msg.sig_abs_active = this.sig_abs_active;
  output(abs_info_oc_msg);
}

on message CCAN::ABS_Neg_Respond_OTA
{

}

on message CCAN::ABS_Pos_Respond_OTA
{

}

on message CCAN::ABS_Request_OBD
{

}

on message CCAN::ABS_Slave_Active
{

}

on message CCAN::AEB_Info_ECU
{

}

on message CCAN::Brake_Control_ECU
{
  brake_control_p_msg.sig_brake_pressed =  this.sig_brake_pressed;
  brake_control_p_msg.sig_brake_level = this.sig_brake_level;
  
  output(brake_control_p_msg);
}

on message CCAN::Brake_Neg_Respond_OTA
{

}

on message CCAN::Brake_Pos_Respond_OTA
{

}

on message CCAN::Brake_Request_OBD
{

}

on message CCAN::Steering_Angle_Info_ECU
{
  steering_info_b_msg.sig_steering_angle = this.sig_steering_angle;
  output(steering_info_b_msg);
}

on message CCAN::Steering_Neg_Respond_OTA
{

}

on message CCAN::Steering_Pos_Respond_OTA
{

}

on message CCAN:: Steering_Request_OBD
{

}



//B-CAN
on message BODY::Illuminate_Info_Cluster
{

}

on message BODY::Illuminate_Neg_Respond_OTA
{

}

on message BODY::Illuminate_Pos_Respond_OTA
{

}

on message BODY::Illuminate_Request_OBD
{

}

on message BODY::Light_Info_Cluster
{
  light_info_oc_msg.sig_fog_light  = this.sig_fog_light;
  light_info_oc_msg.sig_high_beam  = this.sig_high_beam;
  light_info_oc_msg.sig_low_beam   = this.sig_low_beam;
  light_info_oc_msg.sig_drive_mode = this.sig_drive_mode;
  light_info_oc_msg.sig_rain_road = this.sig_rain_road;
  
  output(light_info_oc_msg);
}

on message BODY::Light_Neg_Respond_OTA
{

}

on message BODY::Light_Pos_Respond_OTA
{

}

on message BODY::Light_Request_OBD
{

}

on message BODY::Rain_Neg_Repond_OTA
{

}

on message BODY::Rain_Pos_Respond_OTA
{

}

on message BODY::Rain_Request_OBD
{

}

on message BODY::Seat_Neg_Respond_OTA
{

}

on message BODY::Seat_Pos_Respond_OTA
{

}

on message BODY::Seat_Request_OBD
{

}

on message BODY::Steering_Angle_Info_ECU
{
  steering_angle_oc_msg.sig_steering_angle = this.sig_steering_angle;
  
  output(steering_angle_oc_msg);
}


//ADAS-CAN
on message ADASCAN::ADAS_Control_Brake
{
  aeb_info_oc_msg.sig_aeb_active = this.sig_control_aeb;
  
  output(aeb_info_oc_msg);
}

on message ADASCAN::ADAS_Control_Motor
{
  //motor_control_p_msg.sig_control_speed = this.sig_control_accerleration;//그냥 longitudinal speed를 줘버릴까
  motor_control_p_msg.sig_control_speed = @sysvar::Motor::longitudinal_speed;
  output(motor_control_p_msg);
}

on message ADASCAN::ADAS_Control_Steering
{
  steering_control_c_msg.sig_control_steering = this.sig_control_steering; // todo스티어링에서 계산해서저장해둬야함.
  output(steering_control_c_msg);
}

on message ADASCAN::ADAS_Info_Cluster
{
  adas_info_oc_msg.sig_ACC = this.sig_ACC;
  adas_info_oc_msg.sig_AEB = this.sig_AEB;
  adas_info_oc_msg.sig_LKA = this.sig_LKA;
  output(adas_info_oc_msg);
}

on message ADASCAN::ADAS_Neg_Respond_OTA
{
  
}

on message ADASCAN::ADAS_Pos_Respond_OTA
{
  
}

on message ADASCAN::ADAS_Request_OBD
{
  
}


//OTA-CAN



//OC-CAN
on message OCCAN::Cluster_Neg_Respond_OTA
{
  
}

on message OCCAN::Cluster_Pos_Respond_OTA
{
  
}

on message OCCAN::Cluster_Request_OBD
{
  
}

on message OCCAN::OBD_MIL_Cluster
{
  
}

on message OCCAN::OBD_Neg_Respond_OBD
{
  
}


on message OCCAN::OBD_Neg_Respond_OTA
{
  
}

on message OCCAN::OBD_Pos_Respond_OBD
{
  
}

on message OCCAN::OBD_Pos_Respond_OTA
{
  
}