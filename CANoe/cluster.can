/*@!Encoding:949*/
includes
{
  
}

variables
{
  message Cluster_Pos_Respond_OTA cluster_pos_msg;
  message Cluster_Neg_Respond_OTA cluster_neg_msg;
  
  int my_ecu_name = 17;
  byte rxbuffer[20000];
  int rxoffset = 0;
  int metadata_recved = 0;
  
  // metadata
  int version = 0;
  int file_size = 0;
  
  // file
  dword fd = 0;
}

on message OBD_MIL_Cluster
{
  
}

on message OCCAN::VUM_Request_ECU
{
  if(this.sig_sid ==0x12)
  {
    cluster_pos_msg.sig_sid = this.sig_sid+0x40;
    output(cluster_pos_msg);
  }
  
  if(this.sig_sid ==0x15)
  {
    if(metadata_recved ==1)
    {
      if (rxoffset == file_size)
      {
        cluster_pos_msg.sig_sid = this.sig_sid+0x40;
      }
      else
      {
        cluster_neg_msg.sig_neg_respond = 0x7F;
        cluster_neg_msg.sig_sid = this.sig_sid;
      }
      output(cluster_pos_msg);
    }
  }
  
  //negative
}

on message OC_CAN::VUM_Metadata_ECU
{
  if(this.sig_ecu_name == my_ecu_name)
  {
    file_size = this.sig_file_size;
    version = this.sig_version;
    cluster_pos_msg.sig_sid = this.sig_sid + 0x40;
    output(cluster_pos_msg);
    metadata_recved = 1;
  }
  write("metadata comes in!");
}

dword calcCRC32(byte data[], int len)
{
  int i, j;
  dword temp, crc, mask;
  
  i = 0;
  crc = 0xFFFFFFFF;
  while(i < len){
    temp = (dword)data[i];
    crc = crc ^ temp;
    for (j = 7; j >= 0; j--){
      mask = -(crc & 1);
      crc = (crc >> 1) ^ (0xEDB88320 & mask);
    }
    i = i + 1;
  }
  return ~crc;
}


on message OC_CAN::VUM_File_Cluster
{
  int count = 0;
  int len = 0;

  if (file_size - rxoffset >= 8) {
    len = 8;
  }
  else {
    len = file_size - rxoffset;
  }
  for (count = 0;count < len;count++)
  {
    rxbuffer[rxoffset] = this.byte(count);
    rxoffset++;
  }

  if ((rxoffset % 4096 == 0) || rxoffset == file_size) {
    if(rxoffset == file_size){
      dword receivedCRC;
      dword calculatedCRC;
      int dataLen;

      if (rxoffset > 4)
      {
        dataLen = rxoffset - 4;
        receivedCRC = ((dword)(rxbuffer[dataLen]     & 0XFF) << 24) | 
                      ((dword)(rxbuffer[dataLen + 1] & 0xFF) << 16) | 
                      ((dword)(rxbuffer[dataLen + 2] & 0XFF) << 8)  | 
                      ((dword)(rxbuffer[dataLen + 3])& 0XFF);
        calculatedCRC = calcCRC32(rxbuffer, dataLen);

        write("ECU Received CRC32 = 0x%08X, ECU Calculated CRC32 = 0x%08X", receivedCRC, calculatedCRC);
        
        //file write
        setWritePath("C:\\Users\\USER\\Desktop\\Project3\\ota_results");
        fd = OpenFileWrite ("Cluster.bin",3);
        
        if ( fd!=0 )
        {
          fileWriteBinaryBlock (rxbuffer, dataLen ,fd);
        }
        else
        {
          write ("File 'data.bin' was not opened for write access.");
        }
        
        // file close
        fileClose (fd);
      }
    }
    cluster_pos_msg.sig_sid = 0x14 + 0x40;
    output(cluster_pos_msg);
  }
  
  @sysvar::VUM::update_progress = (int)(((double)rxoffset / (double)file_size) * 100);

  write("payload comes in!, %d", rxoffset);
}