/*@!Encoding:949*/ 
includes
{
  
}

variables
{
  int steering;
  int threshold = 30;
  msTimer sendTimer100a;
  message BODY::Light_Info_Cluster light_info_msg;
}
on start
{
  setTimerCyclic(sendTimer100a, 100); 
}

on timer sendTimer100a
{
  
  if(@sysvar::Light::light_active ==1)
  {
    light_info_msg.sig_low_beam = 1;
    if(@sysvar::Motor::longitudinal_speed <50) 
    {
      light_info_msg.sig_drive_mode = 0;
      light_info_msg.sig_high_beam = 0;
    }
    else if(@sysvar::Motor::longitudinal_speed >50 && @sysvar::Motor::longitudinal_speed <100) 
    {
      light_info_msg.sig_drive_mode = 1;
      light_info_msg.sig_high_beam = 1;
    }
    else 
    {
      light_info_msg.sig_drive_mode = 2;
      light_info_msg.sig_high_beam = 1;
    }
    light_info_msg.sig_fog_light = @sysvar::Light::fog_active;
    output(light_info_msg);
  }
  
  
  write("light_active = %d",@sysvar::Light::light_active);
  
}

on message BODY::Steering_Angle_Info_ECU
{
  if(this.sig_steering_angle>threshold)
  {
    @sysvar::Light::corner_light_left = 1;
    @sysvar::Light::corner_light_right = 0;
  }
  else if(this.sig_steering_angle<(-1*threshold))
  {
    @sysvar::Light::corner_light_right = 1;
    @sysvar::Light::corner_light_left = 0;
  }
  else
  {
    @sysvar::Light::corner_light_left = 0;
    @sysvar::Light::corner_light_right = 0;
  }
  
}


