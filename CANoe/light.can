/*@!Encoding:949*/ 
includes
{
  
}

variables
{
  int steering;
  int threshold = 30;
  int my_ecu_name = 14;
  int rxbuffer[20000];
  int rxoffset = 0;
  int metadata_recved = 0;
  msTimer sendTimer100;
  message BODY::Light_Info_Cluster light_info_msg;
  message Light_Pos_Respond_OTA light_pos_msg;
  message Light_Neg_Respond_OTA light_neg_msg;
  
  // metadata
  int version = 0;
  int file_size = 0;
}
on start
{
  setTimerCyclic(sendTimer100, 100); 
}

on timer sendTimer100
{
  
  if(@sysvar::Light::light_active ==1)
  {
    light_info_msg.sig_low_beam = 1;
    if(@sysvar::Motor::longitudinal_speed <50) 
    {
      light_info_msg.sig_drive_mode = 0;
      light_info_msg.sig_high_beam = 0;
    }
    else if(@sysvar::Motor::longitudinal_speed >50 && @sysvar::Motor::longitudinal_speed <100) 
    {
      light_info_msg.sig_drive_mode = 1;
      light_info_msg.sig_high_beam = 1;
    }
    else 
    {
      light_info_msg.sig_drive_mode = 2;
      light_info_msg.sig_high_beam = 1;
    }
    light_info_msg.sig_fog_light = @sysvar::Light::fog_active;
    output(light_info_msg);
  }
  else
  {
    light_info_msg.sig_low_beam = 0;
    light_info_msg.sig_high_beam = 0;
    light_info_msg.sig_fog_light = 0;
    output(light_info_msg);
  }
  
  
  //write("light_active = %d fog_active = %d high = %d low = %d",@sysvar::Light::light_active,light_info_msg.sig_fog_light,light_info_msg.sig_high_beam,light_info_msg.sig_low_beam);
  
}

on message BODY::Steering_Angle_Info_ECU
{
  if(@sysvar::Light::light_active ==1)
  {
    if(this.sig_steering_angle>threshold)
    {
      @sysvar::Light::corner_light_left = 1;
      @sysvar::Light::corner_light_right = 0;
    }
    else if(this.sig_steering_angle<(-1*threshold))
    {
      @sysvar::Light::corner_light_right = 1;
      @sysvar::Light::corner_light_left = 0;
    }
    else
    {
      @sysvar::Light::corner_light_left = 0;
      @sysvar::Light::corner_light_right = 0;
    }
  }
  
  
}

on message BODY::VUM_Request_ECU
{
  if(this.sig_sid ==0x12)
  {
    light_pos_msg.sig_sid = this.sig_sid+0x40;
    output(light_pos_msg);
  }
  
  if(this.sig_sid ==0x15)
  {
    if(metadata_recved ==1)
    {
      if (rxoffset == file_size)
      {
        light_pos_msg.sig_sid = this.sig_sid+0x40;
      }
      else
      {
        light_neg_msg.sig_neg_respond = 0x7F;
        light_neg_msg.sig_sid = this.sig_sid;
      }
      output(light_pos_msg);
    }
  }
  
  //negative
}

on message B_CAN::VUM_Metadata_ECU
{
  if(this.sig_ecu_name == my_ecu_name)
  {
    file_size = this.sig_file_size;
    version = this.sig_version;
    light_pos_msg.sig_sid = this.sig_sid + 0x40;
    output(light_pos_msg);
    metadata_recved = 1;
  }
  write("metadata comes in!");
}

on message B_CAN::VUM_File_Light
{
  int count = 0;
  int len = 0;

  if (file_size - rxoffset >= 8) {
    len = 8;
  }
  else {
    len = file_size - rxoffset;
  }
  for (count = 0;count < len;count++)
  {
    rxbuffer[rxoffset] = this.byte(count);
    rxoffset++;
  }

  if ((rxoffset % 4000 == 0) || rxoffset == file_size) {
    light_pos_msg.sig_sid = 0x14 + 0x40;
    output(light_pos_msg);
  }
  
  @sysvar::VUM::update_progress = (int)(((double)rxoffset / (double)file_size) * 100);

  write("payload comes in!, %d", rxoffset);
}