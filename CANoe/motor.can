/*@!Encoding:949*/ 
includes
{
  
}

variables
{
  //send message
  message Motor_Info_ECU motor_info_oc_msg;
  message Motor_Pos_Respond_OTA motor_pos_msg;
  message Motor_Neg_Respond_OTA motor_neg_msg;
  //timer
  msTimer t_motor;

  //var
  int brake_pressed = 0;  
  int rxbuffer[20000];
  int rxoffset = 0;
  int my_ecu_name = 0;
  int metadata_recved = 0;
  
  // metadata
  int version = 0;
  int file_size = 0;
  
  
}

on start
{
  setTimerCyclic(t_motor, 5);
}

//ADAS
on message PCAN::ADAS_Control_Motor
{
  motor_info_oc_msg.sig_car_speed = this.sig_control_speed;

  if(@sysvar::Transmission::gear<3&&this.sig_control_speed>0)

  {
    @sysvar::Transmission::gear = 3;
  }
  output(motor_info_oc_msg);
}

on timer t_motor
{     
  if(brake_pressed==0)
  {
     motor_info_oc_msg.sig_car_speed = @Motor::longitudinal_speed;
  }
  else
  {
    if(@Motor::longitudinal_speed>0)
    {
      @Motor::longitudinal_speed--;
      motor_info_oc_msg.sig_car_speed = @Motor::longitudinal_speed;
    }  
  }
  output(motor_info_oc_msg);
}


//Brake
on message Brake_Control_Motor
{
   if(this.sig_brake_pressed==1)
   {
     brake_pressed = 1;
   }
   else
   {
     brake_pressed = 0;
   }
}

on message PCAN::VUM_Request_ECU
{
  if(this.sig_sid ==0x12)
  {
    cancelTimer(t_motor);
    motor_pos_msg.sig_sid = this.sig_sid+0x40;
    output(motor_pos_msg);
  }
  
  if(this.sig_sid ==0x15)
  {
    if(metadata_recved ==1)
    {
      if (rxoffset == file_size)
      {
        motor_pos_msg.sig_sid = this.sig_sid+0x40;
      }
      else
      {
        motor_neg_msg.sig_neg_respond = 0x7F;
        motor_neg_msg.sig_sid = this.sig_sid;
      }
      output(motor_pos_msg);
    }
  }
  
  //negative 
}

on message PCAN::VUM_Metadata_ECU
{
  if(this.sig_ecu_name == my_ecu_name)
  {
    file_size = this.sig_file_size;
    version = this.sig_version;
    motor_pos_msg.sig_sid = this.sig_sid+0x40;
    output(motor_pos_msg);
    metadata_recved = 1;
  }
  write("metadata comes in!");
}

on message P_CAN::VUM_File_Motor
{
  int count = 0;
  int len = 0;
  
  if(file_size - rxoffset >= 8){
    len = 8;
  }
  else{
    len = file_size - rxoffset;
  }
  for(count=0;count<len;count++)
  {
    rxbuffer[rxoffset] = this.byte(count);
    rxoffset++;  
  }
  
  if((rxoffset % 4000 == 0) || rxoffset == file_size){
    motor_pos_msg.sig_sid = 0x14 + 0x40;
    output(motor_pos_msg);
  }
  
  @sysvar::VUM::update_progress = (int)(((double)rxoffset / (double)file_size) * 100);
  
  write("payload comes in!, %d", rxoffset);
}