/*@!Encoding:949*/ 
includes
{
  
}

variables
{
  //send message
  message Motor_Info_ECU motor_info_oc_msg;
  message Motor_Pos_Respond_OTA motor_pos_msg;
  message Motor_Neg_Respond_OTA motor_neg_msg;
  //timer
  msTimer t_5ms;
  msTimer t_100ms;
  //var
  int brake_pressed = 0;  
  int trans_state = 0;
  int threshold = 0;
  int my_ecu_name = 0;
  int rxbuffer[1500];
  int rxoffset = 0;
  int metadata_recved = 0;
}

on start
{
  setTimerCyclic(t_5ms, 5);
  setTimerCyclic(t_100ms, 100);
  //cancelTimer(t_motor);
  //setTimerCyclic(t_motor, 5);
}

//ADAS
on message PCAN::ADAS_Control_Motor
{
  motor_info_oc_msg.sig_car_speed = this.sig_control_speed;
  if(@sysvar::Transmission::gear<3&&this.sig_control_speed>0)
  {
    @sysvar::Transmission::gear = 3;
  }
  write("adas speed: %d\n",this.sig_control_speed);
  write("adas transmisson %d\n",@sysvar::Transmission::gear);
  output(motor_info_oc_msg);
}

on message P_CAN::Transmission_Info_ECU
{
  trans_state = this.sig_gear_mode;
}

on timer t_100ms
{
  if(@sysvar::Motor::accel_pressed&&trans_state>0)
  {
    @Motor::longitudinal_speed++;
  }
  
  if (brake_pressed && @Motor::longitudinal_speed > 0) {
    threshold++; 

    if (threshold < 10) 
      @Motor::longitudinal_speed -= 1;
    else 
      @Motor::longitudinal_speed -= 5;

    if (@Motor::longitudinal_speed < 0) {
      @Motor::longitudinal_speed = 0;
    }

  } else {
    threshold = 0; 
  }
}

on timer t_5ms
{      
  motor_info_oc_msg.sig_car_speed = @Motor::longitudinal_speed;
  output(motor_info_oc_msg);
}


//Brake
on message Brake_Control_Motor
{
   if(this.sig_brake_pressed==1)
   {
     brake_pressed = 1;
   }
   else
   {
     brake_pressed = 0;
   }
}

on message PCAN::VUM_Request_ECU
{
  
  if(this.sig_sid ==0x12)
  {
    cancelTimer(t_5ms);
    cancelTimer(t_100ms);
    motor_pos_msg.sig_sid = this.sig_sid+0x40;
    output(motor_pos_msg);
  }
  
  if(this.sig_sid ==0x15)
  {
    if(metadata_recved ==1)
    {
      if (rxoffset+1 == @sysvar::OTA::pcan_file_size)
      {
        motor_pos_msg.sig_sid = this.sig_sid+0x40;
      }
      else
      {
        motor_neg_msg.sig_neg_respond = 0x7F;
        motor_neg_msg.sig_sid = this.sig_sid;
      }
    }
  }
  
  //negative 
}

on message PCAN::VUM_Metadata_ECU
{
  if(this.sig_ecu_name == my_ecu_name)
  {
    @sysvar::OTA::pcan_file_size = this.sig_file_size;
    motor_pos_msg.sig_sid = this.sig_sid+0x40;
    output(motor_pos_msg);
    metadata_recved = 1;
  }
  
}

on message P_CAN::VUM_File_Motor
{
  int count = 0;
  for(count=0;count<8;count++)
  {
    rxbuffer[rxoffset] = this.byte(count);
    rxoffset++; 
  }
}