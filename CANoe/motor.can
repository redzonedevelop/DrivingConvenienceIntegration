/*@!Encoding:949*/
includes
{
  
}

variables
{
  message PCAN::Motor_Info_ECU motor_info_oc_msg;
  
}

on message PCAN::ADAS_Control_Motor
{
  motor_info_oc_msg.sig_car_speed = @sysvar::Motor::longitudinal_speed;
  if(@sysvar::Transmission::gear<3)
  {
    @sysvar::Transmission::gear = 3;
  }
  
  output(motor_info_oc_msg);
}
