/*@!Encoding:949*/ 
includes
{
  
}

variables
{
  //send message
  message Motor_Info_ECU motor_info_oc_msg;
  message Motor_Pos_Respond_OTA motor_pos_msg;
  //timer
  msTimer t_5ms;
  msTimer t_100ms;
  //var
  int brake_pressed = 0;  
  int trans_state = 0;
  int threshold = 0;
}

on start
{
  setTimerCyclic(t_5ms, 5);
  setTimerCyclic(t_100ms, 100);
  //cancelTimer(t_motor);
  //setTimerCyclic(t_motor, 5);
}

//ADAS
on message PCAN::ADAS_Control_Motor
{
  motor_info_oc_msg.sig_car_speed = this.sig_control_speed;

  if(@sysvar::Transmission::gear<3&&this.sig_control_speed>0)

  {
    @sysvar::Transmission::gear = 3;
  }
  output(motor_info_oc_msg);
}

on message P_CAN::Transmission_Info_ECU
{
  trans_state = this.sig_gear_mode;
}

on timer t_100ms
{
  if(@sysvar::Motor::accel_pressed&&trans_state>0)
  {
    @Motor::longitudinal_speed++;
  }
  
  if (brake_pressed && @Motor::longitudinal_speed > 0) {
    threshold++; 

    if (threshold < 10) 
      @Motor::longitudinal_speed -= 1;
    else 
      @Motor::longitudinal_speed -= 5;

    if (@Motor::longitudinal_speed < 0) {
      @Motor::longitudinal_speed = 0;
    }

  } else {
    threshold = 0; 
  }
}

on timer t_5ms
{      
  motor_info_oc_msg.sig_car_speed = @Motor::longitudinal_speed;
  output(motor_info_oc_msg);
}


//Brake
on message Brake_Control_Motor
{
   if(this.sig_brake_pressed==1)
   {
     brake_pressed = 1;
   }
   else
   {
     brake_pressed = 0;
   }
}

on message PCAN::VUM_Request_ECU
{
  motor_pos_msg.sig_sid = this.sig_sid+0x40;
  output(motor_pos_msg);
  //negative 
}