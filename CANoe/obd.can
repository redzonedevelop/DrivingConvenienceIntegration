/*@!Encoding:949*/
includes
{
  
}

variables
{
  message OBD_Pos_Respond_OTA obd_pos_msg;
  message OBD_Neg_Respond_OTA obd_neg_msg;
  message OBD_MIL_Cluster obd_mil_msg;
  
  int my_ecu_name = 16;
  int rxbuffer[20000];
  int rxoffset = 0;
  int metadata_recved = 0;
  
  // metadata
  int version = 0;
  int file_size = 0;
}

on message ECU_Request_OBD
{
  if(this.sig_sid == 0x10)
  {
    obd_mil_msg.sig_mil=1;
    output(obd_mil_msg);
  }
}

on message OCCAN::VUM_Request_ECU
{
 if(this.sig_sid ==0x12)
  {
    obd_pos_msg.sig_sid = this.sig_sid+0x40;
    output(obd_pos_msg);
  }
  
  if(this.sig_sid ==0x15)
  {
    if(metadata_recved ==1)
    {
      if (rxoffset == file_size)
      {
        obd_pos_msg.sig_sid = this.sig_sid+0x40;
      }
      else
      {
        obd_neg_msg.sig_neg_respond = 0x7F;
        obd_neg_msg.sig_sid = this.sig_sid;
      }
      output(obd_pos_msg);
    }
  }
  
  //negative
}

on message OC_CAN::VUM_Metadata_ECU
{
  if(this.sig_ecu_name == my_ecu_name)
  {
    file_size = this.sig_file_size;
    version = this.sig_version;
    obd_pos_msg.sig_sid = this.sig_sid + 0x40;
    output(obd_pos_msg);
    metadata_recved = 1;
  }
  write("metadata comes in!");
}

on message OC_CAN::VUM_File_OBD
{
  int count = 0;
  int len = 0;

  if (file_size - rxoffset >= 8) {
    len = 8;
  }
  else {
    len = file_size - rxoffset;
  }
  for (count = 0;count < len;count++)
  {
    rxbuffer[rxoffset] = this.byte(count);
    rxoffset++;
  }

  if ((rxoffset % 4000 == 0) || rxoffset == file_size) {
    obd_pos_msg.sig_sid = 0x14 + 0x40;
    output(obd_pos_msg);
  }
  
  @sysvar::VUM::update_progress = (int)(((double)rxoffset / (double)file_size) * 100);

  write("payload comes in!, %d", rxoffset);
}