/*@!Encoding:949*/
includes
{
  
}

variables
{
  message OBD_Pos_Respond_OTA obd_pos_msg;
  message OBD_Neg_Respond_OTA obd_neg_msg;
  
  int my_ecu_name = 16;
  int rxbuffer[1500];
  int rxoffset = 0;
  int metadata_recved = 0;
}

on message OCCAN::VUM_Request_ECU
{
 if(this.sig_sid ==0x12)
  {
    obd_pos_msg.sig_sid = this.sig_sid+0x40;
    output(obd_pos_msg);
  }
  
  if(this.sig_sid ==0x15)
  {
    if(metadata_recved ==1)
    {
      if (rxoffset+1 == @sysvar::OTA::occan_file_size)
      {
        obd_pos_msg.sig_sid = this.sig_sid+0x40;
      }
      else
      {
        obd_neg_msg.sig_neg_respond = 0x7F;
        obd_neg_msg.sig_sid = this.sig_sid;
      }
    }
  }
  
  //negative
}

on message OC_CAN::VUM_Metadata_ECU
{
  if(this.sig_ecu_name == my_ecu_name)
  {
    @sysvar::OTA::occan_file_size = this.sig_file_size;
    obd_pos_msg.sig_sid = this.sig_sid+0x40;
    output(obd_pos_msg);
    metadata_recved = 1;
  }
  
}

on message OC_CAN::VUM_File_OBD
{
  int count = 0;
  for(count=0;count<8;count++)
  {
    rxbuffer[rxoffset] = this.byte(count);
    rxoffset++; 
  }
}