/*@!Encoding:949*/
includes
{
  
}

variables
{
  message Rain_Pos_Respond_OTA rain_pos_msg;
  message Rain_Neg_Repond_OTA rain_neg_msg;
  
  int my_ecu_name = 12;
  int rxbuffer[1500];
  int rxoffset = 0;
  int metadata_recved = 0;
}

on message BODY::VUM_Request_ECU
{
  if(this.sig_sid ==0x12)
  {
    rain_pos_msg.sig_sid = this.sig_sid+0x40;
    output(rain_pos_msg);
  }
  
  if(this.sig_sid ==0x15)
  {
    if(metadata_recved ==1)
    {
      if (rxoffset+1 == @sysvar::OTA::bcan_file_size)
      {
        rain_pos_msg.sig_sid = this.sig_sid+0x40;
      }
      else
      {
        rain_neg_msg.sig_neg_respond = 0x7F;
        rain_neg_msg.sig_sid = this.sig_sid;
      }
    }
  }
  
  //negative
}

on message B_CAN::VUM_Metadata_ECU
{
  if(this.sig_ecu_name == my_ecu_name)
  {
    @sysvar::OTA::bcan_file_size = this.sig_file_size;
    rain_pos_msg.sig_sid = this.sig_sid+0x40;
    output(rain_pos_msg);
    metadata_recved = 1;
  }
  
}

on message B_CAN::VUM_File_Rain
{
  int count = 0;
  for(count=0;count<8;count++)
  {
    rxbuffer[rxoffset] = this.byte(count);
    rxoffset++; 
  }
}