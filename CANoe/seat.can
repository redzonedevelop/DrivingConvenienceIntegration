/*@!Encoding:949*/
includes
{
  
}

variables
{
  message Seat_Pos_Respond_OTA seat_pos_msg;
}

on message BODY::VUM_Request_ECU
{
  seat_pos_msg.sig_sid = this.sig_sid+0x40;
  output(seat_pos_msg);
  
  //negative
}

