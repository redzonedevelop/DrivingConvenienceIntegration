/*@!Encoding:949*/
includes
{
  
}

variables
{
  message Seat_Pos_Respond_OTA seat_pos_msg;
  message Seat_Neg_Respond_OTA seat_neg_msg;
  
  int my_ecu_name = 15;
  int rxbuffer[20000];
  int rxoffset = 0;
  int metadata_recved = 0;
  
  // metadata
  int version = 0;
  int file_size = 0;
}

on message BODY::VUM_Request_ECU
{
  if(this.sig_sid ==0x12)
  {
    seat_pos_msg.sig_sid = this.sig_sid+0x40;
    output(seat_pos_msg);
  }
  
  if(this.sig_sid ==0x15)
  {
    if(metadata_recved ==1)
    {
      if (rxoffset == file_size)
      {
        seat_pos_msg.sig_sid = this.sig_sid+0x40;
      }
      else
      {
        seat_neg_msg.sig_neg_respond = 0x7F;
        seat_neg_msg.sig_sid = this.sig_sid;
      }
      output(seat_pos_msg);
    }
  }
  
  //negative
}

on message B_CAN::VUM_Metadata_ECU
{
  if(this.sig_ecu_name == my_ecu_name)
  {
    file_size = this.sig_file_size;
    version = this.sig_version;
    seat_pos_msg.sig_sid = this.sig_sid + 0x40;
    output(seat_pos_msg);
    metadata_recved = 1;
  }
  write("metadata comes in!");
}

on message B_CAN::VUM_File_Seat
{
  int count = 0;
  int len = 0;

  if (file_size - rxoffset >= 8) {
    len = 8;
  }
  else {
    len = file_size - rxoffset;
  }
  for (count = 0;count < len;count++)
  {
    rxbuffer[rxoffset] = this.byte(count);
    rxoffset++;
  }

  if ((rxoffset % 4000 == 0) || rxoffset == file_size) {
    seat_pos_msg.sig_sid = 0x14 + 0x40;
    output(seat_pos_msg);
  }
  
  @sysvar::VUM::update_progress = (int)(((double)rxoffset / (double)file_size) * 100);

  write("payload comes in!, %d", rxoffset);
}
