/*@!Encoding:949*/
includes
{
}

variables
{
  //send message
  message C_CAN::Steering_Angle_Info_ECU steering_info_msg;
  message Steering_Pos_Respond_OTA steering_pos_msg;
  message Steering_Neg_Respond_OTA steering_neg_msg;
  
  //timer
  msTimer t_steering;

  //var
  int cur_steering_angle = 0;
  int my_ecu_name = 6;
  int rxbuffer[1500];
  int rxoffset = 0;
  int metadata_recved = 0;
}

on start
{
  setTimerCyclic(t_steering, 5); 
}

on timer t_steering
{
  steering_info_msg.sig_steering_angle = @sysvar::Steering::control_steering;

  output(steering_info_msg);
}

on message C_CAN::ADAS_Control_Steering
{
   @sysvar::Steering::control_steering =  this.sig_control_steering;
   steering_info_msg.sig_steering_angle = @sysvar::Steering::control_steering;
  
  output(steering_info_msg);
}

on message CCAN::VUM_Request_ECU
{
  if(this.sig_sid ==0x12)
  {
    cancelTimer(t_steering);
    steering_pos_msg.sig_sid = this.sig_sid+0x40;
    output(steering_pos_msg);
  }
  
  if(this.sig_sid ==0x15)
  {
    if(metadata_recved ==1)
    {
      if (rxoffset+1 == @sysvar::OTA::ccan_file_size)
      {
        steering_pos_msg.sig_sid = this.sig_sid+0x40;
      }
      else
      {
        steering_neg_msg.sig_neg_respond = 0x7F;
        steering_neg_msg.sig_sid = this.sig_sid;
      }
    }
  }
}

on message CCAN::VUM_Metadata_ECU
{
  if(this.sig_ecu_name == my_ecu_name)
  {
    @sysvar::OTA::ccan_file_size = this.sig_file_size;
    steering_pos_msg.sig_sid = this.sig_sid+0x40;
    output(steering_pos_msg);
    metadata_recved = 1;
  }
  
}

on message C_CAN::VUM_File_Steering
{
  int count = 0;
  for(count=0;count<8;count++)
  {
    rxbuffer[rxoffset] = this.byte(count);
    rxoffset++; 
  }
}