/*@!Encoding:949*/
includes
{
}

variables
{
  //send message
  message C_CAN::Steering_Angle_Info_ECU steering_info_msg;
  
  //timer
  msTimer t_steering;

  //var
  int cur_steering_angle = 0;
  int input = 0;
  float scaled = 0.0;
}

on start
{
  setTimerCyclic(t_steering, 5); 
}

on timer t_steering
{
  steering_info_msg.sig_steering_angle = @sysvar::Steering::control_steering;
  
  input = @sysvar::Steering::control_steering;
  scaled = (input + 180.0) * (18.0 / 360.0);
  @sysvar::Steering::steering_switch_value = (int)(scaled + 0.5);  // 반올림

  
  output(steering_info_msg);
}

on message C_CAN::ADAS_Control_Steering
{
   @sysvar::Steering::control_steering =  this.sig_control_steering;
   steering_info_msg.sig_steering_angle = @sysvar::Steering::control_steering;
  
  output(steering_info_msg);
}