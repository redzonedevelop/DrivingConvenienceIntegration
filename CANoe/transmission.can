/*@!Encoding:949*/ 
includes
{
  
}

variables
{
  //send message
  message PCAN::Transmission_Info_ECU transmission_info_msg;
  message Transmission_Pos_Respond_OTA transmission_pos_msg;
  //timer
  msTimer sendTimer100;
  
}

on start 
{
  setTimerCyclic(sendTimer100,100); 
}

on timer sendTimer100
{
  transmission_info_msg.sig_gear_mode = @sysvar::Transmission::gear;

  output(transmission_info_msg); 

}

on message PCAN::VUM_Request_ECU
{
  transmission_pos_msg.sig_sid = this.sig_sid+0x40;
  output(transmission_pos_msg);
  
  //negative
}
