/*@!Encoding:949*/ 
includes
{
  
}

variables
{
  //send message
  message PCAN::Transmission_Info_ECU transmission_info_msg;
  
  //timer
  msTimer sendTimer100;
  
}

on start 
{
  setTimerCyclic(sendTimer100,100); 
}

on timer sendTimer100
{
  transmission_info_msg.sig_gear_mode = @sysvar::Transmission::gear;

  output(transmission_info_msg); 

}
