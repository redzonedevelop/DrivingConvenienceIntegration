/*@!Encoding:949*/
includes
{
  
}

variables
{
  //send message
  message PCAN::Transmission_Info_ECU transmission_info_msg;
  
  //timer
  msTimer sendTimer;
  
}

on start 
{
  setTimerCyclic(sendTimer,100); 
}

on timer sendTimer
{
  transmission_info_msg.sig_gear_mode = @sysvar::Transmission::gear;
}

